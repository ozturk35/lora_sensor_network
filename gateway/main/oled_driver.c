#include "oled_driver.h"
#include "esp_log.h"
#include "freertos/FreeRTOS.h"
#include "freertos/task.h"
#include <string.h>

static const char *TAG = "oled";

#define OLED_ADDR    0x3C
#define OLED_COLS    128
#define OLED_PAGES   8
/* SH1106 internal RAM is 132 columns; visible display starts at column 2 */
#define OLED_COL_OFFSET 2

/* ── Minimal 5×7 font (ASCII 32–127) ──────────────────────────────────── */
static const uint8_t font_5x7[96][5] = {
    {0x00,0x00,0x00,0x00,0x00}, /* ' ' */
    {0x00,0x00,0x5F,0x00,0x00}, /* '!' */
    {0x00,0x07,0x00,0x07,0x00}, /* '"' */
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    {0x00,0x00,0x00,0x00,0x00}, /* DEL */
};

/* ── Internal I2C helpers ───────────────────────────────────────────────── */

static void oled_cmd(oled_t *dev, uint8_t cmd)
{
    uint8_t buf[2] = {0x00, cmd};
    i2c_master_transmit(dev->dev_handle, buf, 2, pdMS_TO_TICKS(10));
}

static void oled_set_cursor(oled_t *dev, uint8_t page, uint8_t col)
{
    uint8_t c = col + OLED_COL_OFFSET;
    oled_cmd(dev, 0xB0 | (page & 0x07));
    oled_cmd(dev, 0x00 | (c & 0x0F));
    oled_cmd(dev, 0x10 | ((c >> 4) & 0x0F));
}

/* ── Public API ─────────────────────────────────────────────────────────── */

esp_err_t oled_init(oled_t *dev, i2c_master_bus_handle_t bus)
{
    i2c_device_config_t cfg = {
        .dev_addr_length = I2C_ADDR_BIT_LEN_7,
        .device_address  = OLED_ADDR,
        .scl_speed_hz    = 400000,
    };
    esp_err_t ret = i2c_master_bus_add_device(bus, &cfg, &dev->dev_handle);
    if (ret != ESP_OK) {
        ESP_LOGE(TAG, "i2c_master_bus_add_device failed: %s", esp_err_to_name(ret));
        return ret;
    }

    static const uint8_t init_seq[] = {
        0xAE,        /* display off */
        0xD5, 0x80,  /* clock divide / oscillator */
        0xA8, 0x3F,  /* multiplex ratio 64 */
        0xD3, 0x00,  /* display offset 0 */
        0x40,        /* display start line 0 */
        0xA1,        /* segment remap: col 127 → SEG0 */
        0xC8,        /* COM scan direction: remapped */
        0xDA, 0x12,  /* COM pins hardware config */
        0x81, 0xCF,  /* contrast */
        0xD9, 0xF1,  /* pre-charge period */
        0xDB, 0x40,  /* VCOMH deselect level */
        0xA4,        /* entire display ON (resume from RAM) */
        0xA6,        /* normal display (not inverted) */
        0xAF,        /* display on */
    };
    for (size_t i = 0; i < sizeof(init_seq); i++) {
        oled_cmd(dev, init_seq[i]);
    }

    ESP_LOGI(TAG, "SH1106G init OK (0x%02X)", OLED_ADDR);
    return ESP_OK;
}

void oled_clear(oled_t *dev)
{
    for (uint8_t page = 0; page < OLED_PAGES; page++) {
        oled_set_cursor(dev, page, 0);
        uint8_t buf[1 + OLED_COLS];
        buf[0] = 0x40; /* data mode */
        memset(&buf[1], 0x00, OLED_COLS);
        i2c_master_transmit(dev->dev_handle, buf, sizeof(buf), pdMS_TO_TICKS(50));
    }
}

void oled_write_string(oled_t *dev, uint8_t page, uint8_t col, const char *str)
{
    oled_set_cursor(dev, page, col);

    while (*str) {
        uint8_t c = (uint8_t)*str++;
        if (c < 32 || c > 127) c = 32;
        const uint8_t *glyph = font_5x7[c - 32];

        /* 5 font bytes + 1 space byte, sent as data stream */
        uint8_t buf[7];
        buf[0] = 0x40; /* data mode */
        memcpy(&buf[1], glyph, 5);
        buf[6] = 0x00; /* inter-character space */
        i2c_master_transmit(dev->dev_handle, buf, 7, pdMS_TO_TICKS(10));
    }
}
