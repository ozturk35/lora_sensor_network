## sensor_node/sdkconfig.defaults
```kconfig
# Target
CONFIG_IDF_TARGET="esp32s3"

# Flash: 8 MB Octal SPI (ESP32-S3R8V)
CONFIG_ESPTOOLPY_FLASHSIZE_8MB=y
CONFIG_ESPTOOLPY_FLASHMODE_OPI=y
CONFIG_ESPTOOLPY_FLASHFREQ_80M=y

# PSRAM: 8 MB Octal
CONFIG_SPIRAM=y
CONFIG_ESP32S3_SPIRAM_SUPPORT=y
CONFIG_SPIRAM_MODE_OCT=y
CONFIG_SPIRAM_SPEED_80M=y

# Console: native USB CDC (VID 303a:1001, ttyACM)
CONFIG_ESP_CONSOLE_USB_CDC=y

# Logging
CONFIG_BOOTLOADER_LOG_LEVEL_WARN=y
CONFIG_LOG_DEFAULT_LEVEL_INFO=y

# Deep sleep: allow flash power-down during sleep
CONFIG_ESP_SLEEP_POWER_DOWN_FLASH=y

# FreeRTOS: 1 kHz ticks
CONFIG_FREERTOS_HZ=1000
```
